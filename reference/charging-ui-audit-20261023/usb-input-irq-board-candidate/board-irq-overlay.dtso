/dts-v1/;
/plugin/;

/ {
    fragment@0 {
        target-path = "/soc@0/spmi@c440000/pmic@2";
        __overlay__ {
            /* Repeat the existing parent cells only for dtc local checks.
             * The merged parent values must remain byte-for-byte equal.
             */
            #address-cells = <1>;
            #size-cells = <0>;
            usb-input@1300 {
                compatible = "realme,rmx1931-usb-input";
                reg = <0x1300>;
                interrupts = <0x2 0x13 0x4 0x3>, <0x2 0x13 0x6 0x1>;
                interrupt-names = "usbin-plugin", "usbin-src-change";
                status = "okay";
            };
        };
    };
};
