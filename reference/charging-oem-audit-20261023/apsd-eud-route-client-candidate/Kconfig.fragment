## reference/charging-oem-audit-20261023/apsd-eud-route-client-candidate/Kconfig.fragment
```kconfig
config USB_DWC3_SAMURAI_APSD_OWNER
	bool "Samurai APSD DWC lifecycle coordinator"
	depends on USB_DWC3=y && USB_DWC3_GADGET
	depends on PHY_QCOM_USB_SNPS_FEMTO_V2=y && POWER_SUPPLY=y
	default n

config USB_DWC3_SAMURAI_APSD_PD5V_CLIENT
	bool "Samurai pre-attach PD-disabled client bridge"
	depends on USB_DWC3_SAMURAI_APSD_OWNER && OF
	depends on TYPEC_TCPM=y && TYPEC_QCOM_PMIC=y
	default n

config USB_DWC3_SAMURAI_APSD_EUD_OFF_CLIENT
	bool "Samurai explicit EFI EUD-off route client"
	depends on USB_DWC3_SAMURAI_APSD_PD5V_CLIENT
	depends on QCOM_SAMURAI_EUD_ROUTE=y
	default n
	help
	  Also needs the actual samurai,apsd-eud-route phandle. The route
	  provider excludes every paired debug producer; no COM quiet-window
	  fallback exists. Boot evidence currently expires at the first PM
	  prepare. Full PM route revalidation and device validation remain.
```

## reference/charging-oem-audit-20261023/apsd-phy-client-candidate/Kconfig.fragment
```kconfig
config USB_DWC3_SAMURAI_APSD_OWNER
	bool "Samurai APSD DWC lifecycle candidate (no attempt gate yet)"
	depends on USB_DWC3=y && USB_DWC3_GADGET
	depends on SERIAL_EUD_CONSOLE=y && PHY_QCOM_USB_SNPS_FEMTO_V2=y
	depends on POWER_SUPPLY=y
	default n
	help
	  Internal optional coordinator, additionally requiring the explicit
	  samurai,apsd-owner property. Missing route and final-transfer
	  coverage refuses every hardware attempt; PHY withdrawal is joined. Not a deployable rerun path.

config USB_DWC3_SAMURAI_APSD_PD5V_CLIENT
 bool "Samurai pre-attach PD-disabled client bridge (no APSD command)"
 depends on USB_DWC3_SAMURAI_APSD_OWNER && OF
 depends on TYPEC_TCPM=y && TYPEC_QCOM_PMIC=y
 default n
 help
   Same-Image internal client only; also requires the explicit DWC
   samurai,apsd-pd5v-bridge and samurai,apsd-typec properties plus the
   PD5V driver's double opt-in. Current TYPEC_QCOM_PMIC=m is refused.
   Establishes real disabled-PD control only after physical detach.
   Missing route/transfer gates still deny every APSD command.
```

## reference/charging-oem-audit-20261023/eud-route-handoff-candidate/Kconfig.fragment
```kconfig
config QCOM_SAMURAI_EUD_HANDOFF
	bool "RMX1931 structured EUD firmware handoff evidence"
	depends on ARM64 && ARCH_QCOM && EFI && OF
	default n
	help
	  Receive the reserved-page record from the paired samurai firmware
	  through its real EFI configuration table. No MMIO, route change or
	  permission is created by receiving this evidence. A separate actual
	  resource-owning, revocable route supplier remains required.
```

## reference/charging-oem-audit-20261023/eud-route-provider-candidate/Kconfig.fragment
```kconfig
config QCOM_SAMURAI_EUD_ROUTE
	bool "RMX1931 boot-disabled EUD route ownership"
	depends on QCOM_SAMURAI_EUD_HANDOFF && ARM64 && ARCH_QCOM && OF
	default n
	help
	  Bind real route/USB devices to the paired firmware evidence and
	  arbitrate every paired EUD producer before MMIO/SCM. The provider
	  owns client references and revokes/joins before releasing exclusion.
	  Boot evidence currently expires at system PM prepare; no resume-time
	  permission is inferred before hardware retention is proved.
```

## reference/charging-session-20261023/apsd-session-owner-candidate/Kconfig.fragment
```kconfig
config USB_DWC3_SAMURAI_APSD_OWNER
	bool "Samurai APSD DWC lifecycle candidate (no attempt gate yet)"
	depends on USB_DWC3=y && USB_DWC3_GADGET
	depends on SERIAL_EUD_CONSOLE=y && PHY_QCOM_USB_SNPS_FEMTO_V2=y
	depends on POWER_SUPPLY=y
	default n
	help
	  Internal optional coordinator, additionally requiring the explicit
	  samurai,apsd-owner property. Missing PD/route and EUD/PHY lifetime
	  coverage refuses every hardware attempt. Not a deployable rerun path.
```
