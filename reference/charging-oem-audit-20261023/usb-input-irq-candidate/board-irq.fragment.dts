/* Add to the board DTS; uses the existing SPMI IRQ controller. */
&spmi_bus {
	pmic@2 {
		samurai_usb_input: usb-input@1300 {
			compatible = "realme,rmx1931-usb-input";
			reg = <0x1300>;
			interrupts = <0x2 0x13 0x4 IRQ_TYPE_EDGE_BOTH>,
				     <0x2 0x13 0x6 IRQ_TYPE_EDGE_RISING>;
			interrupt-names = "usbin-plugin", "usbin-src-change";
			status = "okay";
		};
	};
};
