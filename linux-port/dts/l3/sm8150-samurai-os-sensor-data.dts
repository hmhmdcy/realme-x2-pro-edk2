// SPDX-License-Identifier: BSD-3-Clause
/*
 * L3-02 OS DTB candidate: locked k363 OS tree plus optional sensor-power
 * board data. This wrapper is not part of the frozen v1 source lock.
 */
/dts-v1/;

#include "../split-ba61/sm8150-samurai-os.dts"
#include "sensor-power-data.dtsi"
