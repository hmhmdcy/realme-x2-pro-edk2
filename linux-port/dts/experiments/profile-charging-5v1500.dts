// SPDX-License-Identifier: BSD-3-Clause
/* Charging wiring plus the fixed 5V/1.5A policy. */

/dts-v1/;

#include "../split-ba61/sm8150-samurai-common.dtsi"
#include "samurai-charging-usb-input.dtsi"
#include "samurai-5v1500-policy.dtsi"
