// SPDX-License-Identifier: BSD-3-Clause
/*
 * Source-level wrapper for the PM8150B USB-input wake experiment.
 *
 * This includes the production samurai DTS and adds only the read-only
 * PM8150B USBIN observer.  Compiling this wrapper without -@ keeps the DTB
 * compact enough for the existing boot-image DTB section.
 */

#include <dt-bindings/interrupt-controller/irq.h>
#include "sm8150-samurai.dts"

/*
 * Keep this temporary candidate inside the existing boot-image DTB section.
 * model/chassis-type are not used by the USB wake test.
 */
/ {
	/delete-property/ model;
	/delete-property/ chassis-type;
};

&spmi_bus {
	pmic@2 {
		samurai_usb_input: w@1300 {
			compatible = "realme,usb";
			interrupts = <2 0x13 4 IRQ_TYPE_EDGE_BOTH>;
		};
	};
};
