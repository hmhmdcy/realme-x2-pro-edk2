// SPDX-License-Identifier: BSD-3-Clause
/*
 * Runtime profile for the current samurai experiment without vendor/ABL
 * match properties. Shared hardware lives in the split common DTSI.
 */

/dts-v1/;

#include "../split-ba61/sm8150-samurai-common.dtsi"
#include "samurai-camera-icp.dtsi"
#include "samurai-charging-usb-input.dtsi"
#include "samurai-eud-off-route.dtsi"
#include "samurai-5v1500-policy.dtsi"
#include "samurai-debug-bootargs.dtsi"
