// SPDX-License-Identifier: BSD-3-Clause
/* Camera ICP experiment only; no charging or EUD policy. */

/dts-v1/;

#include "../split-ba61/sm8150-samurai-common.dtsi"
#include "samurai-camera-icp.dtsi"
