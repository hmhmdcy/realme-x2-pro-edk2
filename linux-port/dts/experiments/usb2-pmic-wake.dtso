// SPDX-License-Identifier: BSD-3-Clause
/*
 * Minimal RMX1931 PM8150B USB-input wake observer.
 *
 * This overlay deliberately adds only the read-only USB input observer that
 * consumes the PM8150B USBIN plugin/source-change IRQs.  The existing
 * samurai-usb-input driver arms those IRQs for system sleep, so this is a
 * DTB-only way to test whether the PMIC/SPMI/PDC path can wake the SoC.
 *
 * It does not enable PM8150B Type-C/TCPM, change charging policy, alter the
 * DWC3 role, or add a USB wakeup-source property.
 */

/dts-v1/;
/plugin/;

#include <dt-bindings/interrupt-controller/irq.h>

&spmi_bus {
	pmic@2 {
		#address-cells = <1>;
		#size-cells = <0>;

		samurai_usb_input: usb-input@1300 {
			compatible = "realme,rmx1931-usb-input";
			reg = <0x1300>;
			interrupt-parent = <&spmi_bus>;
			interrupts = <2 0x13 4 IRQ_TYPE_EDGE_BOTH>,
				     <2 0x13 6 IRQ_TYPE_EDGE_RISING>;
			interrupt-names = "usbin-plugin", "usbin-src-change";
			status = "okay";
		};
	};
};
