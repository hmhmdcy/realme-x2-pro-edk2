// SPDX-License-Identifier: BSD-3-Clause
/*
 * Debug/test startup policy from the deployed charging experiment.
 *
 * This is deliberately not a hardware property. Keep it in a debug startup
 * entry or LoadOptions when the UEFI entry migration is validated; do not
 * make it part of the production OS DTB.
 */

/ {
	chosen {
		bootargs = "console=tty0 loglevel=7 ignore_loglevel panic=15 clk_ignore_unused pd_ignore_unused regulator_ignore_unused bq27xxx_battery.samurai_instant_current=1";
	};
};
