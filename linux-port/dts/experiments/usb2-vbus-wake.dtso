// SPDX-License-Identifier: BSD-3-Clause
/*
 * USB2 VBUS/charger-insert wake candidate for RMX1931.
 *
 * The vendor bootloader DT exposes the board's VBUS-detect input as the
 * standard extcon-usb-gpio binding on PM8150 GPIO10.  Keep the data path
 * unchanged and model only that hardware fact here.
 *
 * The SPMI PMIC arbiter's PDC parent is described in sm8150.dtsi, not
 * here: it is SoC integration, not board wiring.  With that parent in
 * place, the PM8150 GPIO10 child interrupt can be armed through the
 * standard enable_irq_wake() path.
 *
 * Wakeup enablement is userspace policy: the platform udev rule sets
 * power/wakeup=enabled. The extcon binding has no wakeup-source property,
 * so it is deliberately not described here.
 */

/dts-v1/;
/plugin/;

#include <dt-bindings/gpio/gpio.h>

&pm8150_gpios {
	usb2_vbus_det_default: usb2-vbus-det-default-state {
		pins = "gpio10";
		function = "normal";
		input-enable;
		bias-pull-down;
		power-source = <1>;
	};
};

&{/} {
	extcon_usb1: extcon-usb1 {
		compatible = "linux,extcon-usb-gpio";
		vbus-gpios = <&pm8150_gpios 10 GPIO_ACTIVE_HIGH>;
		pinctrl-names = "default";
		pinctrl-0 = <&usb2_vbus_det_default>;
	};
};
