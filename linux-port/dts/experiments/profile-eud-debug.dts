// SPDX-License-Identifier: BSD-3-Clause
/* EUD route and debug startup policy only. */

/dts-v1/;

#include "../split-ba61/sm8150-samurai-common.dtsi"
#include "samurai-eud-off-route.dtsi"
#include "samurai-debug-bootargs.dtsi"
