// SPDX-License-Identifier: BSD-3-Clause
/* Charging wiring only; no 5V1500 policy, camera ICP, or EUD route. */

/dts-v1/;

#include "../split-ba61/sm8150-samurai-common.dtsi"
#include "samurai-charging-usb-input.dtsi"
