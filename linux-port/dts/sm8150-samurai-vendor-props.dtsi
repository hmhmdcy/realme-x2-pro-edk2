// SPDX-License-Identifier: BSD-3-Clause
/*
 * Vendor/ABL matching properties for the RMX1931 compatibility DTB.
 *
 * These properties are not a Linux hardware ABI. Include this fragment only
 * in the vendor/compat DTS that is appended to the boot image. The OS-facing
 * DTB currently comes from the boot image itself, not from the logdump FAT;
 * neither OS-facing location should depend on these properties.
 */

/ {
	qcom,msm-id = <339 0x20000>;
	qcom,board-id = <0 0>;
	oppo,dtsi_no = <19781>;
};
