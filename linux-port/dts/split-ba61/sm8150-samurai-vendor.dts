// SPDX-License-Identifier: BSD-3-Clause
/*
 * Realme X2 Pro (RMX1931CN), codename "samurai".
 *
 * OS-facing source split from the locked k363 board description.
 * Shared hardware lives in sm8150-samurai-common.dtsi.
 */
/dts-v1/;

#include "sm8150-samurai-common.dtsi"

/ {
	qcom,msm-id = <339 0x20000>;
	qcom,board-id = <0 0>;
	oppo,dtsi_no = <19781>;
};
